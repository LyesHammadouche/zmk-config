## config/boards/shields/corne_cherry_v4/Kconfig.shield
```kconfig
# SPDX-License-Identifier: MIT

config SHIELD_CORNE_CHERRY_V4_LEFT
    def_bool $(shields_list_contains,corne_cherry_v4_left)

config SHIELD_CORNE_CHERRY_V4_RIGHT
    def_bool $(shields_list_contains,corne_cherry_v4_right)
```

## config/west.yml
```yaml
manifest:
  remotes:
    - name: zmkfirmware
      url-base: https://github.com/zmkfirmware
    - name: gpeye
      url-base: https://github.com/GPeye
    - name: dsifry
      url-base: https://github.com/dsifry
  projects:
    - name: zmk
      remote: zmkfirmware
      revision: v0.3
      import: app/west.yml
    - name: urchin-peripheral-animation
      remote: gpeye
      revision: main
    - name: nice-view-mod
      remote: dsifry
      revision: main
  self:
    path: config
```
